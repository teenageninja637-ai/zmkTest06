## config/west.yml
```yaml
manifest:
  defaults:
    revision: v0.3
    remotes:
    - name: zmkfirmware
      url-base: https://github.com/zmkfirmware
    - name: zmkTest06 #new entry
      url-base: https://github.com/teenageninja637-ai #new entry
  projects:
    - name: zmk
      remote: zmkfirmware
      revision: v0.3.0
      import: app/west.yml
    - name: zmkTest06 #new entry
      remote: zmkTest06 #new entry
  self:
    path: config
```
